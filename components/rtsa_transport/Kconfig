## components/rtsa_transport/Kconfig
```kconfig
menu "RTSA Transport"
    config RTSA_CHANNEL_ID
        string "RTSA channel ID"
        default ""
        help
            Channel identifier used by the RTSA SDK to pair two devices.
            Leave empty until the SDK is integrated.
endmenu
```

## components/sensor/Kconfig
```kconfig
menu "Sensor"
    config SENSOR_SAMPLE_RATE_HZ
        int "Force sensor polling rate (Hz)"
        default 100
        range 10 1000
        help
            How often the force sensor is sampled per second.
endmenu
```

## main/Kconfig.projbuild
```kconfig
menu "HapticHatch"
    config HAPTIC_QUEUE_DEPTH
        int "Haptic receive queue depth"
        default 4
        help
            FreeRTOS queue depth for incoming haptic packets.
            Oldest packets are dropped when full to maintain low latency.

    menu "Signaling Demo"
        config AGORA_APP_ID
            string "Agora App ID"
            default ""
            help
                Agora project App ID from the Agora Console.

        config AGORA_SIGNALING_UID_A
            string "Signaling UID A"
            default "device_a"
            help
                First peer identity (max 64 chars).

        config AGORA_SIGNALING_UID_B
            string "Signaling UID B"
            default "device_b"
            help
                Second peer identity (max 64 chars).

        config AGORA_SIGNALING_TOKEN_A
            string "Signaling token for UID A"
            default ""
            help
                Token issued for UID A. Leave empty to disable token auth.

        config AGORA_SIGNALING_TOKEN_B
            string "Signaling token for UID B"
            default ""
            help
                Token issued for UID B. Leave empty to disable token auth.

        config AGORA_SIGNALING_DEVICE_ID
            string "Device ID for this board (A or B)"
            default "A"
            help
                Identity this build takes at runtime.
                  "A" → login as UID A, send to UID B
                  "B" → login as UID B, send to UID A
                Change to "B" between the two flashes so each board takes a
                different identity; tokens do not need to be regenerated.

        config DEMO_WIFI_SSID
            string "WiFi SSID"
            default ""
            help
                SSID of the 2.4 GHz WiFi network to connect to.

        config DEMO_WIFI_PASSWORD
            string "WiFi password"
            default ""
            help
                Password for the WiFi network. Leave empty for open networks.
    endmenu
endmenu
```

## sdkconfig.defaults
```kconfig
# Target chip
CONFIG_IDF_TARGET="esp32s3"

# Flash size — ESP32-S3 module with 8 MB flash
CONFIG_ESPTOOLPY_FLASHSIZE_8MB=y
CONFIG_ESPTOOLPY_FLASHSIZE="8MB"

# PSRAM — 8 MB OPI PSRAM (AP_3v3, embedded on the chip)
CONFIG_SPIRAM=y
CONFIG_SPIRAM_MODE_OCT=y
CONFIG_SPIRAM_SPEED_80M=y
CONFIG_SPIRAM_MALLOC_ALWAYSINTERNAL=16384

# Partition table — 3 MB app partition to fit the Agora RTSA SDK
CONFIG_PARTITION_TABLE_CUSTOM=y
CONFIG_PARTITION_TABLE_CUSTOM_FILENAME="partitions.csv"
CONFIG_PARTITION_TABLE_FILENAME="partitions.csv"

# Forward declaration — defined in components/sensor/Kconfig (Task 2)
CONFIG_SENSOR_SAMPLE_RATE_HZ=100

# Defined in main/Kconfig.projbuild
CONFIG_HAPTIC_QUEUE_DEPTH=4

# Forward declaration — defined in components/rtsa_transport/Kconfig (Task 4)
CONFIG_RTSA_CHANNEL_ID=""

CONFIG_AGORA_APP_ID="YOUR APP ID"
CONFIG_AGORA_SIGNALING_UID_A="device_a"
CONFIG_AGORA_SIGNALING_UID_B="device_b"
CONFIG_AGORA_SIGNALING_TOKEN_A="YOUR ACCESS TOKEN FOR UID A"
CONFIG_AGORA_SIGNALING_TOKEN_B="YOUR ACCESS TOKEN FOR UID B"
# Change to "B" when flashing the second board.
CONFIG_AGORA_SIGNALING_DEVICE_ID="A"
CONFIG_DEMO_WIFI_SSID="AGORA_AI_KIT"
CONFIG_DEMO_WIFI_PASSWORD="*"
```
